/ {
	amba_pl: amba_pl {
		ranges;
		compatible = "simple-bus";
		#address-cells = <1>;
		#size-cells = <1>;
		myip_slave_register_0: myip_slave_register@43c00000 {
			xlnx,s00-axi-data-width = <32>;
			xlnx,rable = <0>;
			compatible = "xlnx,myip-slave-register-1.0";
			status = "okay";
			clock-names = "s00_axi_aclk";
			xlnx,s00-axi-addr-width = <5>;
			xlnx,ip-name = "myip_slave_register";
			xlnx,edk-iptype = "PERIPHERAL";
			reg = <0x43c00000 0x10000>;
			clocks = <&clkc 15>;
			xlnx,name = "myip_slave_register_0";
		};
	};
};
